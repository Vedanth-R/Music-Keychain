## boards/shields/music_keychain/Kconfig.defconfig
```kconfig
# SPDX-License-Identifier: MIT

if SHIELD_MUSIC_KEYCHAIN || SHIELD_MUSIC_KEYCHAIN_BUILD_TEST

config ZMK_KEYBOARD_NAME
    default "Music Keychain"

endif
```

## boards/shields/music_keychain/Kconfig.shield
```kconfig
# SPDX-License-Identifier: MIT

config SHIELD_MUSIC_KEYCHAIN
    def_bool $(shields_list_contains,music_keychain)

config SHIELD_MUSIC_KEYCHAIN_BUILD_TEST
    def_bool $(shields_list_contains,music_keychain_build_test)
```

## dts/bindings/behaviors/zmk,behavior-immediate-soft-off.yaml
```yaml
description: Enter ZMK soft-off immediately when pressed

compatible: "zmk,behavior-immediate-soft-off"

include: zero_param.yaml
```
